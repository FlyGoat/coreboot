## src/mainboard/lenovo/x230/Kconfig
```kconfig
if BOARD_LENOVO_X230 || BOARD_LENOVO_X230I

config BOARD_SPECIFIC_OPTIONS # dummy
	def_bool y
	select SYSTEM_TYPE_LAPTOP
	select CPU_INTEL_SOCKET_RPGA989
	select NORTHBRIDGE_INTEL_IVYBRIDGE
	select USE_NATIVE_RAMINIT
	select SOUTHBRIDGE_INTEL_C216
	select EC_LENOVO_PMH7
	select EC_LENOVO_H8
	select NO_UART_ON_SUPERIO
	select BOARD_ROMSIZE_KB_12288
	select HAVE_ACPI_TABLES
	select HAVE_OPTION_TABLE
	select HAVE_CMOS_DEFAULT
	select HAVE_ACPI_RESUME
	select INTEL_INT15
	select SANDYBRIDGE_IVYBRIDGE_LVDS
	select DRIVERS_RICOH_RCE822
	select MAINBOARD_HAS_LPC_TPM
	select MAINBOARD_HAS_LIBGFXINIT
	select GFX_GMA_INTERNAL_IS_LVDS

	# Workaround for EC/KBC IRQ1.
	select SERIRQ_CONTINUOUS_MODE

choice

	depends on BOARD_LENOVO_X230I

	prompt "X230i CPU TYPE"

	config BROAD_HAVE_SANDYBRIDGE_I3_CPU
		bool "X230i with SandyBridge i3 CPU"
		default y

	config BROAD_HAVE_SANDYBRIDGE_CELERON_CPU
		bool "X230i with SandyBridge Celeron CPU"

	config BROAD_HAVE_IVYBRIDGE_I3_CPU
		bool "X230i with IvyBridge i3 CPU"

endchoice

config HAVE_IFD_BIN
	bool
	default n

config HAVE_ME_BIN
	bool
	default n

config MAINBOARD_DIR
	string
	default lenovo/x230

config MAINBOARD_PART_NUMBER
	string
	default "ThinkPad X230"

config MAX_CPUS
	int
	default 8

config USBDEBUG_HCD_INDEX
	int
	default 2

config DRAM_RESET_GATE_GPIO
	int
	default 10

config VGA_BIOS_FILE
	string
	default "pci8086,0116.rom" if BROAD_HAVE_SANDYBRIDGE_I3_CPU
	default "pci8086,0106.rom" if BROAD_HAVE_SANDYBRIDGE_CELERON_CPU
	default "pci8086,0166.rom"

config VGA_BIOS_ID
	string
	default "8086,0116" if BROAD_HAVE_SANDYBRIDGE_I3_CPU
	default "8086,0106" if BROAD_HAVE_SANDYBRIDGE_CELERON_CPU
	default "8086,0166"

config MAINBOARD_PCI_SUBSYSTEM_VENDOR_ID
	hex
	default 0x17aa

config MAINBOARD_PCI_SUBSYSTEM_DEVICE_ID
	hex
	default 0x21fa

endif # BOARD_LENOVO_X230
```

## src/mainboard/lenovo/x230/Kconfig.name
```kconfig
config BOARD_LENOVO_X230
	bool "ThinkPad X230"

config BOARD_LENOVO_X230I
	bool "ThinkPad X230i"
```
